## drivers/input/touchscreen/focaltech_3683g/Kconfig
```kconfig
#
# Focaltech Touchscreen driver configuration
#

config TOUCHSCREEN_FOCALTECH_FT3683G
    tristate "Focaltech Touchscreen"
    default m
    help
      Say Y here if you have Focaltech touch panel.
      If unsure, say N.
```

## drivers/leds/trigger/Kconfig
```kconfig
config LEDS_TRIGGER_BACKLIGHT_DRM
	tristate "LED backlight Trigger using DRM notifier"
	help
	  This allows LEDs to be controlled as a backlight device: they
	  turn off and on when the display is blanked and unblanked.

	  If unsure, say N.
```
